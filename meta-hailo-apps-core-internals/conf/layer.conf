## meta-hailo-apps-core-internals/conf/layer.conf
```bitbake
# We have a conf and classes directory, add to BBPATH
BBPATH .= ":${LAYERDIR}"

HAILO_APPS_CORE_GSTREAMER += "${LAYERDIR}/recipes-gstreamer/*/*.bb \
                              ${LAYERDIR}/recipes-gstreamer/*/*.bbappend "

BBFILES += " ${@bb.utils.contains('BBFILE_COLLECTIONS', 'meta-hailo-apps-core', '${HAILO_APPS_CORE_GSTREAMER}', '', d)}"

LICENSE_PATH = "${LAYERDIR}/licenses/"
BBFILE_COLLECTIONS += "meta-hailo-apps-core-internals"
BBFILE_PATTERN_meta-hailo-apps-core-internals = "^${LAYERDIR}/"
BBFILE_PRIORITY_meta-hailo-apps-core-internals = "9"

LAYERDEPENDS_meta-hailo-apps-core-internals = "core"
LAYERSERIES_COMPAT_meta-hailo-apps-core-internals = "scarthgap"

HW_ARCH = "hailo8"
```

## meta-hailo-tappas-internals/conf/layer.conf
```bitbake
# We have a conf and classes directory, add to BBPATH
BBPATH .= ":${LAYERDIR}"

TAPPAS_CORE += "${LAYERDIR}/recipes-core/*/*.bb \
                ${LAYERDIR}/recipes-core/*/*.bbappend "

TAPPAS_GSTREAMER += "${LAYERDIR}/recipes-gstreamer/*/*.bb \
                     ${LAYERDIR}/recipes-gstreamer/*/*.bbappend "
BBFILES += " ${@bb.utils.contains('BBFILE_COLLECTIONS', 'meta-hailo-tappas', '${TAPPAS_CORE}', '', d)}"
BBFILES += " ${@bb.utils.contains('BBFILE_COLLECTIONS', 'meta-hailo-tappas', '${TAPPAS_GSTREAMER}', '', d)}"

BBFILE_COLLECTIONS += "meta-hailo-tappas-internals"
BBFILE_PATTERN_meta-hailo-tappas-internals = "^${LAYERDIR}/"
BBFILE_PRIORITY_meta-hailo-tappas-internals = "8"

LAYERDEPENDS_meta-hailo-tappas-internals = "core"
LAYERSERIES_COMPAT_meta-hailo-tappas-internals = "dunfell"
```
