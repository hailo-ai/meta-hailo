## meta-hailo-tappas/conf/layer.conf
```bitbake
# We have a conf and classes directory, add to BBPATH
BBPATH .= ":${LAYERDIR}"

# We have recipes-* directories, add to BBFILES
BBFILES += "${LAYERDIR}/recipes-*/*/*.bb \
            ${LAYERDIR}/recipes-*/*/*.bbappend"

BBFILE_COLLECTIONS += "meta-hailo-tappas"
BBFILE_PATTERN_meta-hailo-tappas = "^${LAYERDIR}/"
BBFILE_PRIORITY_meta-hailo-tappas = "8"

LICENSE_PATH = "${LAYERDIR}/licenses/"

LAYERDEPENDS_meta-hailo-tappas = "core meta-hailo-libhailort"
LAYERSERIES_COMPAT_meta-hailo-tappas = "kirkstone"

CORE_IMAGE_EXTRA_INSTALL:append = " packagegroup-hailo-tappas${@bb.utils.contains('HAILO_TARGET', 'core-image-hailo', '', '-dev-pkg', d)}"
```

## meta-hailo-vpu/conf/layer.conf
```bitbake
# We have a conf and classes directory, add to BBPATH
BBPATH .= ":${LAYERDIR}"

# We have recipes-* directories, add to BBFILES
BBFILES += "${LAYERDIR}/recipes-*/*/*.bb \
            ${LAYERDIR}/recipes-*/*/*.bbappend"

BBFILE_COLLECTIONS += "meta-hailo-vpu"
BBFILE_PATTERN_meta-hailo-vpu = "^${LAYERDIR}/"
BBFILE_PRIORITY_meta-hailo-vpu = "8"

LAYERDEPENDS_meta-hailo-vpu = "\
    core \
    meta-hailo-libhailort"

LAYERSERIES_COMPAT_meta-hailo-vpu = "kirkstone"
```
